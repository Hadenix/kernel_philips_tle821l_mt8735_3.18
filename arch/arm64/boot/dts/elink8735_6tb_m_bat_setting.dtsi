/*************************
 * Customized Battery Setting dtsi file
*************************/
&bat_comm {
	/* cust_charging.h */

	/* Charging Current Setting */
	usb_charger_current = <50000 >;	/* Unit: 0.01 mA */
	ac_charger_input_current = <200000 >; /* Unit: 0.01 mA */
	ac_charger_current = <200000 >;	/* Unit: 0.01 mA */
	non_std_ac_charger_current = <200000 >;	/* Unit: 0.01 mA */
	charging_host_charger_current = <50000 >;	/* Unit: 0.01 mA */

	/* charger error check */
	bat_low_temp_protect_enable = <0 >;
	v_charger_enable = <0 >;	/* 1:on , 0:off */
	v_charger_max = <6500 >;	/* unit: mV */
	v_charger_min = <4400 >;

	/*  Tracking TIME */
	onehundred_percent_tracking_time = <10 >;	/* Unit: second */
	npercent_tracking_time = <20 >;	/* Unit: second */
	sync_to_real_tracking_time = <60 >;	/* Unit: second */
	v_0percent_tracking = <3450 >;	/* Unit: mV */

	/* High battery support */
	high_battery_voltage_support = <1 >;
};

&bat_meter {
	/* cust_battery_meter.h */
	/* ADC resistor  */
	r_bat_sense = <4 >;
	r_i_sense = <4 >;
	r_charger_1 = <330 >;
	r_charger_2 = <39 >;
	temperature_t0 = <110 >;
	temperature_t1 = <0 >;
	temperature_t2 = <25 >;
	temperature_t3 = <50 >;
	temperature_t = <255 >;	/* this should be fixed, never change the value */
	fg_meter_resistance = <0 >;

	/* Qmax for 0mA */
	q_max_pos_50 = <5000 >;
	q_max_pos_25 = <5000 >;
	q_max_pos_0 = <5000 >;
	q_max_neg_10 = <5000 >;
	/* Qmax for 400mA, said high current */
	q_max_pos_50_h_current = <5000 >;
	q_max_pos_25_h_current = <5000 >;
	q_max_pos_0_h_current = <5000 >;
	q_max_neg_10_h_current = <5000 >;
	/* Discharge percentage, 1: D5, 0: D2 */
	oam_d5 = <1 >;

	change_tracking_point = <1 >;
	/* SW OCV tracking setting */
	cust_tracking_point = <1 >;
	cust_r_sense = <68 >;
	cust_hw_cc = <0 >;
	aging_tuning_value = <103 >;
	cust_r_fg_offset = <0 >;
	ocv_board_compesate = <0 >;
	r_fg_board_base = <1000 >;
	r_fg_board_slope = <1000 >;
	car_tune_value = <99 >;

	/* HW Fuel gague  */
	current_detect_r_fg = <10 >;	/* Unit: mA */
	minerroroffset = <1000 >;
	fg_vbat_average_size = <18 >;
	r_fg_value = <10 >;	/* Unit: mOhm */

	cust_poweron_delta_capacity_tolrance = <30 >;
	cust_poweron_low_capacity_tolrance = <5 >;
	cust_poweron_max_vbat_tolrance = <90 >;
	cust_poweron_delta_vbat_tolrance = <30 >;
	cust_poweron_delta_hw_sw_ocv_capacity_tolrance = <10 >;

	/* Fixed battery temperature */
	fixed_tbat_25 = <1>;

	/* Battery remove detecton */
	vbat_remove_detection = <0>;

	/* Dynamic change wake up period of battery thread when suspend */
	vbat_normal_wakeup = <3600 >;	/* Unit: mV */
	vbat_low_power_wakeup = <3500 >;	/* Unit: mV */
	normal_wakeup_period = <5400 >;	/* Unit: second */
	low_power_wakeup_period = <300 >;	/* Unit: second */
	close_poweroff_wakeup_period = <30 >;	/* Unit: second */

	rbat_pull_up_r = <16900 >;
	rbat_pull_up_volt = <1800 >;

	batt_temperature_table_num = <17 >;
	batt_temperature_table = <
	    (-20) 69709
	    (-15) 54633
	    (-10) 43155
	    (-5) 34343
	    0 27523
	    5 22206
	    10 18031
	    15 14730
	    20 12103
	    25 10000
	    30 8306
	    35 6935
	    40 5818
	    45 4904
	    50 4152
	    55 3531
	    60 3016
	>;

	battery_profile_t0_num = <100 >;
	battery_profile_t0 = <
		0   4333
		1   4316
		2   4302
		3   4290
		4   4278
		5   4264
		6   4250
		7   4240
		8   4228
		9   4219
		10  4205
		11  4192
		12  4182
		13  4172
		14  4163
		15  4150
		16  4138
		17  4127
		18  4117
		19  4108
		20  4098
		21  4087
		22  4076
		23  4071
		24  4066
		25  4058
		26  4040
		27  4021
		28  4006
		29  3997
		30  3988
		31  3982
		32  3978
		33  3974
		34  3968
		35  3960
		36  3953
		37  3944
		38  3937
		39  3930
		40  3923
		41  3913
		42  3901
		43  3892
		44  3882
		45  3873
		46  3864
		47  3856
		48  3850
		49  3845
		50  3841
		51  3836
		52  3831
		53  3826
		54  3823
		55  3819
		56  3815
		57  3812
		58  3808
		59  3804
		60  3802
		61  3799
		62  3795
		63  3792
		64  3791
		65  3788
		66  3786
		67  3784
		68  3782
		69  3779
		70  3777
		71  3775
		72  3771
		73  3768
		74  3765
		75  3762
		76  3759
		77  3755
		78  3751
		79  3748
		80  3745
		81  3742
		82  3739
		83  3733
		84  3726
		85  3721
		86  3717
		87  3712
		88  3704
		89  3696
		90  3693
		91  3691
		92  3691
		93  3689
		94  3687
		95  3682
		96  3666
		97  3631
		98  3572
		99  3490
		100 3422
	>;

	battery_profile_t1_num = <100 >;
	battery_profile_t1 = <
		0   4333
		1   4316
		2   4302
		3   4290
		4   4278
		5   4264
		6   4250
		7   4240
		8   4228
		9   4219
		10  4205
		11  4192
		12  4182
		13  4172
		14  4163
		15  4150
		16  4138
		17  4127
		18  4117
		19  4108
		20  4098
		21  4087
		22  4076
		23  4071
		24  4066
		25  4058
		26  4040
		27  4021
		28  4006
		29  3997
		30  3988
		31  3982
		32  3978
		33  3974
		34  3968
		35  3960
		36  3953
		37  3944
		38  3937
		39  3930
		40  3923
		41  3913
		42  3901
		43  3892
		44  3882
		45  3873
		46  3864
		47  3856
		48  3850
		49  3845
		50  3841
		51  3836
		52  3831
		53  3826
		54  3823
		55  3819
		56  3815
		57  3812
		58  3808
		59  3804
		60  3802
		61  3799
		62  3795
		63  3792
		64  3791
		65  3788
		66  3786
		67  3784
		68  3782
		69  3779
		70  3777
		71  3775
		72  3771
		73  3768
		74  3765
		75  3762
		76  3759
		77  3755
		78  3751
		79  3748
		80  3745
		81  3742
		82  3739
		83  3733
		84  3726
		85  3721
		86  3717
		87  3712
		88  3704
		89  3696
		90  3693
		91  3691
		92  3691
		93  3689
		94  3687
		95  3682
		96  3666
		97  3631
		98  3572
		99  3490
		100 3422
	>;

	battery_profile_t2_num = <100 >;
	battery_profile_t2 = <
		0   4333
		1   4316
		2   4302
		3   4290
		4   4278
		5   4264
		6   4250
		7   4240
		8   4228
		9   4219
		10  4205
		11  4192
		12  4182
		13  4172
		14  4163
		15  4150
		16  4138
		17  4127
		18  4117
		19  4108
		20  4098
		21  4087
		22  4076
		23  4071
		24  4066
		25  4058
		26  4040
		27  4021
		28  4006
		29  3997
		30  3988
		31  3982
		32  3978
		33  3974
		34  3968
		35  3960
		36  3953
		37  3944
		38  3937
		39  3930
		40  3923
		41  3913
		42  3901
		43  3892
		44  3882
		45  3873
		46  3864
		47  3856
		48  3850
		49  3845
		50  3841
		51  3836
		52  3831
		53  3826
		54  3823
		55  3819
		56  3815
		57  3812
		58  3808
		59  3804
		60  3802
		61  3799
		62  3795
		63  3792
		64  3791
		65  3788
		66  3786
		67  3784
		68  3782
		69  3779
		70  3777
		71  3775
		72  3771
		73  3768
		74  3765
		75  3762
		76  3759
		77  3755
		78  3751
		79  3748
		80  3745
		81  3742
		82  3739
		83  3733
		84  3726
		85  3721
		86  3717
		87  3712
		88  3704
		89  3696
		90  3693
		91  3691
		92  3691
		93  3689
		94  3687
		95  3682
		96  3666
		97  3631
		98  3572
		99  3490
		100 3422
	>;

	battery_profile_t3_num = <100 >;
	battery_profile_t3 = <
		0   4333
		1   4316
		2   4302
		3   4290
		4   4278
		5   4264
		6   4250
		7   4240
		8   4228
		9   4219
		10  4205
		11  4192
		12  4182
		13  4172
		14  4163
		15  4150
		16  4138
		17  4127
		18  4117
		19  4108
		20  4098
		21  4087
		22  4076
		23  4071
		24  4066
		25  4058
		26  4040
		27  4021
		28  4006
		29  3997
		30  3988
		31  3982
		32  3978
		33  3974
		34  3968
		35  3960
		36  3953
		37  3944
		38  3937
		39  3930
		40  3923
		41  3913
		42  3901
		43  3892
		44  3882
		45  3873
		46  3864
		47  3856
		48  3850
		49  3845
		50  3841
		51  3836
		52  3831
		53  3826
		54  3823
		55  3819
		56  3815
		57  3812
		58  3808
		59  3804
		60  3802
		61  3799
		62  3795
		63  3792
		64  3791
		65  3788
		66  3786
		67  3784
		68  3782
		69  3779
		70  3777
		71  3775
		72  3771
		73  3768
		74  3765
		75  3762
		76  3759
		77  3755
		78  3751
		79  3748
		80  3745
		81  3742
		82  3739
		83  3733
		84  3726
		85  3721
		86  3717
		87  3712
		88  3704
		89  3696
		90  3693
		91  3691
		92  3691
		93  3689
		94  3687
		95  3682
		96  3666
		97  3631
		98  3572
		99  3490
		100 3422
	>;

	r_profile_t0_num = <100 >;
	r_profile_t0 = <
		106 4333
		109 4316
		108 4302
		108 4290
		108 4278
		110 4264
		107 4250
		109 4240
		107 4228
		110 4219
		108 4205
		109 4192
		108 4182
		108 4172
		110 4163
		110 4150
		111 4138
		111 4127
		111 4117
		112 4108
		115 4098
		114 4087
		115 4076
		118 4071
		119 4066
		118 4058
		118 4040
		117 4021
		114 4006
		118 3997
		117 3988
		117 3982
		120 3978
		120 3974
		119 3968
		117 3960
		118 3953
		120 3944
		117 3937
		120 3930
		119 3923
		118 3913
		115 3901
		117 3892
		112 3882
		108 3873
		107 3864
		110 3856
		109 3850
		107 3845
		108 3841
		110 3836
		111 3831
		111 3826
		112 3823
		110 3819
		111 3815
		115 3812
		116 3808
		115 3804
		115 3802
		116 3799
		116 3795
		117 3792
		117 3791
		120 3788
		120 3786
		121 3784
		121 3782
		119 3779
		119 3777
		118 3775
		113 3771
		114 3768
		114 3765
		114 3762
		113 3759
		114 3755
		115 3751
		114 3748
		115 3745
		114 3742
		114 3739
		115 3733
		115 3726
		115 3721
		116 3717
		118 3712
		119 3704
		118 3696
		119 3693
		117 3691
		120 3691
		121 3689
		125 3687
		127 3682
		126 3666
		126 3631
		133 3572
		143 3490
		150 3422
	>;

	r_profile_t1_num = <100 >;
	r_profile_t1 = <
		106 4333
		109 4316
		108 4302
		108 4290
		108 4278
		110 4264
		107 4250
		109 4240
		107 4228
		110 4219
		108 4205
		109 4192
		108 4182
		108 4172
		110 4163
		110 4150
		111 4138
		111 4127
		111 4117
		112 4108
		115 4098
		114 4087
		115 4076
		118 4071
		119 4066
		118 4058
		118 4040
		117 4021
		114 4006
		118 3997
		117 3988
		117 3982
		120 3978
		120 3974
		119 3968
		117 3960
		118 3953
		120 3944
		117 3937
		120 3930
		119 3923
		118 3913
		115 3901
		117 3892
		112 3882
		108 3873
		107 3864
		110 3856
		109 3850
		107 3845
		108 3841
		110 3836
		111 3831
		111 3826
		112 3823
		110 3819
		111 3815
		115 3812
		116 3808
		115 3804
		115 3802
		116 3799
		116 3795
		117 3792
		117 3791
		120 3788
		120 3786
		121 3784
		121 3782
		119 3779
		119 3777
		118 3775
		113 3771
		114 3768
		114 3765
		114 3762
		113 3759
		114 3755
		115 3751
		114 3748
		115 3745
		114 3742
		114 3739
		115 3733
		115 3726
		115 3721
		116 3717
		118 3712
		119 3704
		118 3696
		119 3693
		117 3691
		120 3691
		121 3689
		125 3687
		127 3682
		126 3666
		126 3631
		133 3572
		143 3490
		150 3422
	>;

	r_profile_t2_num = <100 >;
	r_profile_t2 = <
		106 4333
		109 4316
		108 4302
		108 4290
		108 4278
		110 4264
		107 4250
		109 4240
		107 4228
		110 4219
		108 4205
		109 4192
		108 4182
		108 4172
		110 4163
		110 4150
		111 4138
		111 4127
		111 4117
		112 4108
		115 4098
		114 4087
		115 4076
		118 4071
		119 4066
		118 4058
		118 4040
		117 4021
		114 4006
		118 3997
		117 3988
		117 3982
		120 3978
		120 3974
		119 3968
		117 3960
		118 3953
		120 3944
		117 3937
		120 3930
		119 3923
		118 3913
		115 3901
		117 3892
		112 3882
		108 3873
		107 3864
		110 3856
		109 3850
		107 3845
		108 3841
		110 3836
		111 3831
		111 3826
		112 3823
		110 3819
		111 3815
		115 3812
		116 3808
		115 3804
		115 3802
		116 3799
		116 3795
		117 3792
		117 3791
		120 3788
		120 3786
		121 3784
		121 3782
		119 3779
		119 3777
		118 3775
		113 3771
		114 3768
		114 3765
		114 3762
		113 3759
		114 3755
		115 3751
		114 3748
		115 3745
		114 3742
		114 3739
		115 3733
		115 3726
		115 3721
		116 3717
		118 3712
		119 3704
		118 3696
		119 3693
		117 3691
		120 3691
		121 3689
		125 3687
		127 3682
		126 3666
		126 3631
		133 3572
		143 3490
		150 3422
	>;

	r_profile_t3_num = <100 >;
	r_profile_t3 = <
		106 4333
		109 4316
		108 4302
		108 4290
		108 4278
		110 4264
		107 4250
		109 4240
		107 4228
		110 4219
		108 4205
		109 4192
		108 4182
		108 4172
		110 4163
		110 4150
		111 4138
		111 4127
		111 4117
		112 4108
		115 4098
		114 4087
		115 4076
		118 4071
		119 4066
		118 4058
		118 4040
		117 4021
		114 4006
		118 3997
		117 3988
		117 3982
		120 3978
		120 3974
		119 3968
		117 3960
		118 3953
		120 3944
		117 3937
		120 3930
		119 3923
		118 3913
		115 3901
		117 3892
		112 3882
		108 3873
		107 3864
		110 3856
		109 3850
		107 3845
		108 3841
		110 3836
		111 3831
		111 3826
		112 3823
		110 3819
		111 3815
		115 3812
		116 3808
		115 3804
		115 3802
		116 3799
		116 3795
		117 3792
		117 3791
		120 3788
		120 3786
		121 3784
		121 3782
		119 3779
		119 3777
		118 3775
		113 3771
		114 3768
		114 3765
		114 3762
		113 3759
		114 3755
		115 3751
		114 3748
		115 3745
		114 3742
		114 3739
		115 3733
		115 3726
		115 3721
		116 3717
		118 3712
		119 3704
		118 3696
		119 3693
		117 3691
		120 3691
		121 3689
		125 3687
		127 3682
		126 3666
		126 3631
		133 3572
		143 3490
		150 3422
	>;
};
